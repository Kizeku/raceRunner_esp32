#include <Wire.h>
#include <Adafruit_GFX.h>
#include <Adafruit_SSD1306.h>
#include <esp_random.h>

#define SCREEN_WIDTH 128  // OLED display width, in pixels
#define SCREEN_HEIGHT 64  // OLED display height, in pixels

#define OLED_RESET -1        // Reset pin # (or -1 if sharing Arduino reset pin)
#define SCREEN_ADDRESS 0x3C  ///< See datasheet for Address; 0x3D for 128x64, 0x3C for 128x32
Adafruit_SSD1306 display(SCREEN_WIDTH, SCREEN_HEIGHT, &Wire, OLED_RESET);

#define BOOT_PIN 0



struct Player{
  uint8_t road = 0;
  uint8_t loseZone = 26;
};

Player Pcar;

struct Trash{
  uint8_t  place     = 120;
  bool     active    = false;
  uint16_t spawnTime = 10000;
  uint8_t  hardLvl   = 2;
};
Trash thingsOnRoad[2];

volatile bool gameStart = false;

const uint8_t game_speed = 50;


static const unsigned char PROGMEM line[] = { 0b00000111, 0b11111111, 0b11111111, 0b11111111, 0b11111111, 0b11111111, 0b11111111, 0b11111111, 0b11111111, 0b11111111, 0b11111111, 0b11111111, 0b11111111, 0b11111111, 0b11111111, 0b11100000 };

static const unsigned char PROGMEM load[] = { 0x0, 0x0, 0x0, 0x0, 0x0, 0x0, 0x0, 0x0, 0x0, 0x0, 0x0, 0x0, 0x0,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 0x0, 0x0 };

static const unsigned char PROGMEM road[] = { 0x0, 0x0, 0x0, 0x0, 0x0, 0x0, 0x0, 0x0, 0x0, 0x0, 0x0, 0x0, 0x0,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 0x0, 0x0 };

static const unsigned char PROGMEM road2[] = { 0x0, 0x0, 0x0, 0x0, 0x0, 0x0, 0x0, 0x0, 0x0, 0x0, 0x0, 0x0, 0x0,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 0x0, 0x0 };

static const unsigned char PROGMEM road3[] = { 0x0, 0x0, 0x0, 0x0, 0x0, 0x0, 0x0, 0x0, 0x0, 0x0, 0x0, 0x0, 0x0,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 0x0, 0x0 };

static const unsigned char PROGMEM road4[] = { 0x0, 0x0, 0x0, 0x0, 0x0, 0x0, 0x0, 0x0, 0x0, 0x0, 0x0, 0x0, 0x0,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 0x0, 0x0 };

static const unsigned char PROGMEM road5[] = { 0x0, 0x0, 0x0, 0x0, 0x0, 0x0, 0x0, 0x0, 0x0, 0x0, 0x0, 0x0, 0x0,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 0x0, 0x0 };

#define CAR_WIDTH 16
#define CAR_HEIGHT 16

static const unsigned char PROGMEM car[] = { 0x0, 0x0, 0x0, 0x0, 0x0, 0x0, 0x38, 0x38, 0x10, 0x10, 0x3f, 0xfc, 0x3f, 0xfc, 0x3f, 0xfc, 0x3f, 0xfc, 0x3f, 0xfc, 0x3f, 0xfc, 0x10, 0x10, 0x38, 0x38, 0x0, 0x0, 0x0, 0x0, 0x0, 0x0 };

#define OPSITIONCAR_WIDTH 16
#define OPSITIONCAR_HEIGHT 16

static const unsigned char PROGMEM opsitioncar[] = { 0x0, 0x0, 0x0, 0x9c, 0x39, 0x88, 0x13, 0x88, 0x17, 0xfc, 0x1f, 0xfc, 0x1f, 0xfc, 0x3f, 0xfc, 0x3f, 0xfc, 0x1f, 0xfc, 0x1f, 0xfc, 0x17, 0xfc, 0x13, 0x88, 0x39, 0x88, 0x0, 0x9c, 0x0, 0x0 };

#define TRASHWOOD_WIDTH 8
#define TRASHWOOD_HEIGHT 16

static const unsigned char PROGMEM trashwood[] = { 0x7c, 0x78, 0x70, 0x7c, 0x7f, 0x3d, 0x1c, 0x1c, 0x1e, 0x3f, 0x7d, 0x7c, 0x44, 0x66, 0xc2, 0x0 };


volatile uint32_t lastIsrMs  = 0;
volatile uint8_t roadLine = 0;
void IRAM_ATTR onBootPress(){
    uint32_t now = millis();
    if(now - lastIsrMs > 50){
        if(Pcar.road == 1)Pcar.road = 0;
        else Pcar.road = 1;
        lastIsrMs = now;
    }
}


volatile int x = 10;
const int y = 30;

volatile uint32_t lastUpdate = 0;

void loadScreen(uint16_t progress){
  uint32_t now = millis();
  if(now - lastUpdate >= 300){
    for(int i = 0 ; i < progress; i ++)
      display.drawPixel(x+i, y, WHITE);
    x += progress;
    lastUpdate = now;
    display.display();
  }
  
}

void frameUpdat(){
  static uint8_t i = 0;
  static uint32_t lastTashTime = 0;
  static bool trashActive= false;
  uint32_t now = millis();
  if((now-lastUpdate) >game_speed){
    display.clearDisplay();

    switch (i){
      case 0:
        display.drawBitmap(0,0,road,128,32,WHITE);
        display.drawBitmap(0,33,road5,128,32,WHITE);
      break;
      case 1:
        display.drawBitmap(0,0,road2,128,32,WHITE);
        display.drawBitmap(0,33,road4,128,32,WHITE);
      break;
      case 2:
        display.drawBitmap(0,0,road3,128,32,WHITE);
        display.drawBitmap(0,33,road3,128,32,WHITE);
      break;
      case 3:
        display.drawBitmap(0,0,road4,128,32,WHITE);
        display.drawBitmap(0,33,road2,128,32,WHITE);
      break;
      case 4:
        display.drawBitmap(0,0,road5,128,32,WHITE);
        display.drawBitmap(0,33,road,128,32,WHITE);
      break;
    }
    i++;
    if(i >4) i =0;
    display.drawBitmap(0,31,line,128,1,WHITE);

    if(Pcar.road == 0){
      display.drawBitmap(10,12,car,CAR_WIDTH,CAR_HEIGHT,WHITE);
    }else{
      display.drawBitmap(10,42,car,CAR_WIDTH,CAR_HEIGHT,WHITE);
    }

    if((now - lastTashTime) >= thingsOnRoad[0].spawnTime){// вывод мусора на попутной дороге
      lastTashTime = now;
      thingsOnRoad[0].active = true; 
    }
    if(thingsOnRoad[0].active){
      trashWorker();
    }
    
    // вывод машины на встречке
    
    
    display.display();

    lastUpdate = now;
  }
}

void trashWorker(){
   // пока так чистто проверить отрисовку и проигрыш 
  if(thingsOnRoad[0].active){
    display.drawBitmap(thingsOnRoad[0].place, 10, trashwood, TRASHWOOD_WIDTH, TRASHWOOD_HEIGHT, WHITE);
    if(thingsOnRoad[0].place == 0){ 
      thingsOnRoad[0].active    = false;
      thingsOnRoad[0].spawnTime = 2000 + (esp_random() % 3000);
      thingsOnRoad[0].hardLvl   = 2 + (esp_random() % 4); // случайная скорость движения 
    }
    thingsOnRoad[0].place -= thingsOnRoad[0].hardLvl;
  }
}

void loseCheck(bool & gameLose){
  if((thingsOnRoad[0].place <= 26) && (Pcar.road == 0)){
    gameLose = true;
  }
}

void setup() {
  Serial.begin(9600);

  pinMode(BOOT_PIN, INPUT_PULLUP);
  attachInterrupt(BOOT_PIN, onBootPress, FALLING);

    // SSD1306_SWITCHCAPVCC = generate display voltage from 3.3V internally
  if (!display.begin(SSD1306_SWITCHCAPVCC, SCREEN_ADDRESS)) {
    Serial.println(F("SSD1306 allocation failed"));
    for (;;);  // Don't proceed, loop forever
  }
  display.clearDisplay();
  display.setTextSize(1);
  display.setTextColor(WHITE);
  display.setCursor(10, 20);
  display.println("Loading");
  display.display();
}

void loop() {
  static bool gameLose  = false;
  static bool endScreen = true;
  if(x < 100){
    uint16_t prog = 5+ (esp_random() % 10);
    loadScreen(prog);
    gameStart = true;
  }else if (gameStart && !(gameLose)){
    frameUpdat();
    loseCheck(gameLose);
  }
  if(gameLose && endScreen){
    display.clearDisplay();
    display.setTextSize(1);
    display.setTextColor(WHITE);
    display.setCursor(24, 24);
    display.println("You Lose !");
    display.setCursor(24, 44);
    display.print("Your Time : ");
    display.println(millis()/1000);
    display.display();
    endScreen = false;
    delay(1000);
    ESP.restart();
  }
}
